## components/platform/Kconfig
```kconfig
menu "Air Quality Monitor"

config AIRMON_SCD41_I2C_PORT_NUM
    int "SCD41 I2C port"
    range 0 1
    default 0

config AIRMON_SCD41_I2C_SDA_GPIO
    int "SCD41 I2C SDA GPIO"
    default 8

config AIRMON_SCD41_I2C_SCL_GPIO
    int "SCD41 I2C SCL GPIO"
    default 9

config AIRMON_SGP41_I2C_PORT_NUM
    int "SGP41 I2C port"
    range 0 1
    default 0

config AIRMON_SGP41_I2C_SDA_GPIO
    int "SGP41 I2C SDA GPIO"
    default 8

config AIRMON_SGP41_I2C_SCL_GPIO
    int "SGP41 I2C SCL GPIO"
    default 9

config AIRMON_BMP390_I2C_PORT_NUM
    int "BMP390 I2C port"
    range 0 1
    default 0

config AIRMON_BMP390_I2C_SDA_GPIO
    int "BMP390 I2C SDA GPIO"
    default 8

config AIRMON_BMP390_I2C_SCL_GPIO
    int "BMP390 I2C SCL GPIO"
    default 9

config AIRMON_BMP390_I2C_ADDRESS
    hex "BMP390 I2C address"
    range 0x76 0x77
    default 0x77

config AIRMON_SPS30_UART_PORT_NUM
    int "SPS30 UART port"
    range 0 2
    default 1

config AIRMON_SPS30_UART_TX_GPIO
    int "SPS30 UART TX GPIO"
    default 17

config AIRMON_SPS30_UART_RX_GPIO
    int "SPS30 UART RX GPIO"
    default 18

config AIRMON_SPS30_UART_BAUD_RATE
    int "SPS30 UART baud rate"
    default 115200

config AIRMON_SPS30_AUTO_CLEANING_INTERVAL_SEC
    int "SPS30 auto cleaning interval (seconds)"
    range 0 2592000
    default 604800

config AIRMON_SPS30_WARMUP_SEC
    int "SPS30 warmup after power-up or wake (seconds)"
    range 5 120
    default 30

config AIRMON_PUBLISH_INTERVAL_DEFAULT
    int "Default publish interval (seconds)"
    range 5 60
    default 10

config AIRMON_WIFI_MAX_RETRY
    int "Wi-Fi retry attempts before AP fallback"
    range 3 120
    default 20

config AIRMON_WIFI_CONNECT_TIMEOUT_MS
    int "Wi-Fi connect timeout (ms)"
    range 3000 120000
    default 30000

config AIRMON_AP_FALLBACK_TIMEOUT_SEC
    int "Runtime offline timeout before AP fallback"
    range 30 900
    default 180

config AIRMON_AP_SSID_PREFIX
    string "SoftAP SSID prefix"
    default "airmon"

config AIRMON_GITHUB_OTA_ENABLED
    bool "Enable GitHub OTA auto update"
    default y

if AIRMON_GITHUB_OTA_ENABLED

config AIRMON_GITHUB_RELEASE_OWNER
    string "GitHub release owner"
    default "HiMyCocoo"

config AIRMON_GITHUB_RELEASE_REPO
    string "GitHub release repository"
    default "air-quality-monitor"

config AIRMON_GITHUB_OTA_ASSET_PREFIX
    string "GitHub OTA asset filename prefix"
    default "air_quality_monitor-ota-"

endif

endmenu
```

## sdkconfig.defaults
```kconfig
CONFIG_IDF_TARGET="esp32s3"
CONFIG_PARTITION_TABLE_CUSTOM=y
CONFIG_PARTITION_TABLE_CUSTOM_FILENAME="partitions.csv"
CONFIG_COMPILER_OPTIMIZATION_SIZE=y
CONFIG_ESPTOOLPY_FLASHSIZE_4MB=y
CONFIG_MBEDTLS_CERTIFICATE_BUNDLE=y
# CONFIG_MBEDTLS_CERTIFICATE_BUNDLE_DEFAULT_FULL is not set
CONFIG_MBEDTLS_CERTIFICATE_BUNDLE_DEFAULT_CMN=y
CONFIG_BT_ENABLED=y
CONFIG_BT_NIMBLE_ENABLED=y
# CONFIG_BT_NIMBLE_ROLE_CENTRAL is not set
CONFIG_BT_NIMBLE_ROLE_PERIPHERAL=y
CONFIG_BT_NIMBLE_ROLE_BROADCASTER=y
# CONFIG_BT_NIMBLE_ROLE_OBSERVER is not set
# CONFIG_BT_NIMBLE_GATT_CLIENT is not set
CONFIG_BT_NIMBLE_GATT_SERVER=y
CONFIG_BT_NIMBLE_MAX_CONNECTIONS=1
# CONFIG_BT_NIMBLE_50_FEATURE_SUPPORT is not set
# CONFIG_BT_NIMBLE_PROX_SERVICE is not set
# CONFIG_BT_NIMBLE_ANS_SERVICE is not set
# CONFIG_BT_NIMBLE_CTS_SERVICE is not set
# CONFIG_BT_NIMBLE_HTP_SERVICE is not set
# CONFIG_BT_NIMBLE_IPSS_SERVICE is not set
# CONFIG_BT_NIMBLE_TPS_SERVICE is not set
# CONFIG_BT_NIMBLE_IAS_SERVICE is not set
# CONFIG_BT_NIMBLE_LLS_SERVICE is not set
# CONFIG_BT_NIMBLE_SPS_SERVICE is not set
# CONFIG_BT_NIMBLE_HR_SERVICE is not set
# CONFIG_BT_NIMBLE_BAS_SERVICE is not set
# CONFIG_BT_NIMBLE_DIS_SERVICE is not set
CONFIG_ESP_PROTOCOMM_SUPPORT_SECURITY_VERSION_1=y
# CONFIG_MQTT_TRANSPORT_WEBSOCKET is not set
# CONFIG_MQTT_TRANSPORT_WEBSOCKET_SECURE is not set
CONFIG_AIRMON_GITHUB_OTA_ENABLED=y
CONFIG_AIRMON_SCD41_I2C_PORT_NUM=0
CONFIG_AIRMON_SCD41_I2C_SDA_GPIO=8
CONFIG_AIRMON_SCD41_I2C_SCL_GPIO=9
CONFIG_AIRMON_SGP41_I2C_PORT_NUM=0
CONFIG_AIRMON_SGP41_I2C_SDA_GPIO=8
CONFIG_AIRMON_SGP41_I2C_SCL_GPIO=9
CONFIG_AIRMON_BMP390_I2C_PORT_NUM=0
CONFIG_AIRMON_BMP390_I2C_SDA_GPIO=8
CONFIG_AIRMON_BMP390_I2C_SCL_GPIO=9
CONFIG_AIRMON_BMP390_I2C_ADDRESS=0x77
CONFIG_AIRMON_SPS30_UART_PORT_NUM=1
CONFIG_AIRMON_SPS30_UART_TX_GPIO=17
CONFIG_AIRMON_SPS30_UART_RX_GPIO=18
CONFIG_AIRMON_SPS30_UART_BAUD_RATE=115200
CONFIG_AIRMON_SPS30_AUTO_CLEANING_INTERVAL_SEC=604800

CONFIG_LWIP_SNTP_MAX_SERVERS=2
```
